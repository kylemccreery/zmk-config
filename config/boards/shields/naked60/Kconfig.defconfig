## config/west.yml
```yaml
manifest:
  remotes:
    - name: kylezmk
      url-base: https://github.com/kylemccreery
  projects:
    - name: zmk
      remote: kylezmk
      revision: s40nc
      import: app/west.yml
  self:
    path: config
```
